## src/Kconfig.projbuild
```kconfig
menu "User Settings"

config WIFI_SSID
    string "WiFi SSID"
    default "Kryptos"

config WIFI_PASSWORD
    string "WiFi Password"
    default "13572468"

config BOT_TOKEN
    string "Telegram Bot Token"
    default "8438508129:AAEaH39kNp5BDXTvC4kqovybLFZxN0M1IlA"

config CHAT_ID
    string "Telegram Chat ID"
    default "349691021"

endmenu
```
